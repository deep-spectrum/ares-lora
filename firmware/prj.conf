## CMakeLists.txt
```
cmake_minimum_required(VERSION 3.20.0)
find_package(Zephyr REQUIRED HINTS $ENV{ZEPHYR_BASE})

project(lora-start)

include(${ZEPHYR_BASE}/samples/subsys/usb/common/common.cmake)

include_directories(include)

set(SRC
        src/main.c
        src/settings.c
        src/lora_handlers.c
)

set(SERIAL_SRC
        src/serial/frame.c
        src/serial/serial.c
        src/serial/serial_backend.c
)

set(LORA_SRC
        src/lora/lora.c
        src/lora/packet.c
)

set(BLE_SRC
        src/ble/ble.c
        src/ble/services/ares_service.c
)

set(SHELL_SRC
        src/shell/ble.c
)

if ($ENV{CLION_IDE})
    include_directories(generated_includes)
endif ()

target_sources(app PRIVATE ${SRC} ${SERIAL_SRC} ${LORA_SRC} ${BLE_SRC})
target_sources_ifdef(CONFIG_SHELL app PRIVATE ${SHELL_SRC})
target_sources_ifndef(CONFIG_SHELL app PRIVATE src/serial_commands.c)

target_sources_ifdef(CONFIG_LORA_BACKEND_LORA app PRIVATE src/lora/backends/lora_backend.c)
target_sources_ifndef(CONFIG_LORA_BACKEND_LORA app PRIVATE src/lora/backends/dummy_backend.c)

zephyr_iterable_section(NAME ares_serial_command
        KVMA RAM_REGION GROUP RODATA_REGION
        SUBALIGN Z_LINK_ITERABLE_SUBALIGN)
zephyr_linker_sources(SECTIONS linker/ares_iterables_rom.ld)
```

## Kconfig
```
mainmenu "Lora Application"

menu "Application Configurations"

rsource "config/Kconfig.serial"

rsource "config/Kconfig.lora"

rsource "config/Kconfig.ble"

endmenu  # Application Configurations

source "samples/subsys/usb/common/Kconfig.sample_usbd"

source "Kconfig.zephyr"
```

## sysbuild.conf
```
SB_CONFIG_BOOTLOADER_MCUBOOT=y
SB_CONFIG_BOOT_SIGNATURE_KEY_FILE="\${APP_DIR}/lora_private_key.pem"
SB_CONFIG_BOOT_SIGNATURE_TYPE_ECDSA_P256=y
```

## prj.conf
```kconfig
# LoRa
CONFIG_LORA=y
CONFIG_CRC=y

# Serial
CONFIG_SERIAL=y
CONFIG_UART_INTERRUPT_DRIVEN=y
CONFIG_UART_LINE_CTRL=y
CONFIG_CONSOLE=y
CONFIG_RING_BUFFER=y

CONFIG_USB_DEVICE_STACK_NEXT=y
CONFIG_SAMPLE_USBD_PRODUCT="Ares LoRa"
CONFIG_SAMPLE_USBD_MANUFACTURER="CMU"
CONFIG_UART_USE_RUNTIME_CONFIGURE=y
CONFIG_USBD_CDC_ACM_CLASS=y
CONFIG_UDC_NRF_THREAD_STACK_SIZE=1024

CONFIG_BOOT_BANNER=n
CONFIG_NCS_BOOT_BANNER=n
CONFIG_LOG=n

CONFIG_GPIO=y

# Settings
CONFIG_FLASH=y
CONFIG_FLASH_PAGE_LAYOUT=y
CONFIG_FLASH_MAP=y
CONFIG_NVS=y
CONFIG_SETTINGS=y
CONFIG_SETTINGS_RUNTIME=y

# DFU
CONFIG_MCUMGR=y
CONFIG_MCUMGR_GRP_OS=y
CONFIG_MCUMGR_GRP_IMG=y
CONFIG_MCUMGR_TRANSPORT_UART=y
CONFIG_NET_BUF=y
CONFIG_ZCBOR=y
CONFIG_IMG_MANAGER=y
CONFIG_STREAM_FLASH=y
CONFIG_BASE64=y

CONFIG_PWM=y

# BLE
CONFIG_BT=y
CONFIG_BT_DEVICE_NAME_DYNAMIC=y
CONFIG_BT_PERIPHERAL=y
CONFIG_BT_DEVICE_NAME="Ares"
CONFIG_BT_GATT_CLIENT=y
CONFIG_BT_PERIPHERAL_PREF_MIN_INT=24
CONFIG_BT_PERIPHERAL_PREF_MAX_INT=24
CONFIG_BT_PERIPHERAL_PREF_LATENCY=0
CONFIG_BT_PERIPHERAL_PREF_TIMEOUT=400
CONFIG_BT_GAP_AUTO_UPDATE_CONN_PARAMS=y
CONFIG_BT_USER_PHY_UPDATE=y

# 244 bytes of payload
CONFIG_BT_USER_DATA_LEN_UPDATE=y
CONFIG_BT_L2CAP_TX_MTU=247
CONFIG_BT_BUF_ACL_TX_SIZE=251
CONFIG_BT_BUF_ACL_RX_SIZE=251
CONFIG_BT_CTLR_DATA_LENGTH_MAX=251
CONFIG_BT_RX_STACK_SIZE=2048

CONFIG_SYSTEM_WORKQUEUE_STACK_SIZE=4096
CONFIG_MAIN_STACK_SIZE=2048
CONFIG_BT_BUF_CMD_TX_COUNT=2
CONFIG_BT_CTLR_PHY_CODED=y
CONFIG_ARES_SERIAL_RX_RINGBUF_LEN=2048
```

## usb-legacy.conf
```kconfig
# Legacy USB driver (This one works with USB DFU)
CONFIG_USB_DEVICE_STACK=y
CONFIG_USB_DEVICE_PRODUCT="LoRa"
CONFIG_USB_DEVICE_MANUFACTURER="CMU"
CONFIG_USB_DEVICE_PID=0x1234
CONFIG_USB_DEVICE_VID=0x4321
```

## usb.conf
```kconfig
# New USB stack (This one does not work with DFU enabled)
CONFIG_USB_DEVICE_STACK_NEXT=y
# CONFIG_CDC_ACM_SERIAL_INITIALIZE_AT_BOOT=y
# CONFIG_CDC_ACM_SERIAL_PID=0x0004
# CONFIG_CDC_ACM_SERIAL_PRODUCT_STRING="LoRa Start"
# CONFIG_CDC_ACM_SERIAL_MANUFACTURER_STRING="CMU"
CONFIG_UART_USE_RUNTIME_CONFIGURE=y
CONFIG_USBD_CDC_ACM_CLASS=y
```

## src/main.c
```c
#include <led.h>
#include <zephyr/drivers/gpio.h>
#include <zephyr/drivers/pwm.h>
#include <zephyr/kernel.h>
#include <zephyr/logging/log.h>

LOG_MODULE_REGISTER(main);

#define SLEEP_TIME_MS 1000
#define TRY_AGAIN_MS  10

#define PWM_SLEEP_MS  25u
#define PWM_STEPS     50u

enum led_state_internal {
    INTERNAL_OFF,
    INTERNAL_ON,
    INTERNAL_BLINK_OFF,
    INTERNAL_BLINK_ON,
    INTERNAL_FADE_UP,
    INTERNAL_FADE_DOWN,
};

struct pwm_led {
    const struct pwm_dt_spec led;
    uint32_t next_width;
    uint32_t step;
    enum led_state_internal internal_state;
    enum led_state state;
    struct k_mutex lock;
    struct k_work_delayable blink_work;
    struct k_work_delayable fade_work;
};

// clang-format off
static struct pwm_led pwm_leds[] = { // NOLINT(*-interfaces-global-init)
    // clang-format on
    {
        .led = PWM_DT_SPEC_GET(DT_NODELABEL(pwm_led0)),
        .internal_state = INTERNAL_BLINK_OFF,
        .state = LED_STATE_BLINK,
    },

    {
        .led = PWM_DT_SPEC_GET(DT_NODELABEL(pwm_led1)),
        .internal_state = INTERNAL_OFF,
        .state = LED_STATE_OFF,
    },
};

static struct pwm_led *pwm_led_from_blink_work(struct k_work_delayable *dwork) {
    return CONTAINER_OF(dwork, struct pwm_led, blink_work);
}

static struct pwm_led *pwm_led_from_fade_work(struct k_work_delayable *dwork) {
    return CONTAINER_OF(dwork, struct pwm_led, fade_work);
}

static void fade_up(struct pwm_led *led) {
    led->next_width += led->step;
    if (led->next_width >= led->led.period) {
        led->next_width = led->led.period;
        led->internal_state = INTERNAL_FADE_DOWN;
    }
}

static void fade_down(struct pwm_led *led) {
    if (led->next_width <= led->step) {
        led->next_width = 0;
        led->internal_state = INTERNAL_FADE_UP;
    } else {
        led->next_width -= led->step;
    }
}

static void fade_work(struct k_work *work) {
    struct k_work_delayable *dwork = k_work_delayable_from_work(work);
    struct pwm_led *led = pwm_led_from_fade_work(dwork);

    int ret = k_mutex_lock(&led->lock, K_NO_WAIT);
    if (ret < 0) {
        k_work_schedule(dwork, K_MSEC(TRY_AGAIN_MS));
        return;
    }

    if (led->state != LED_STATE_FADE) {
        k_mutex_unlock(&led->lock);
        return;
    }

    ret = pwm_set_pulse_dt(&led->led, led->next_width);
    if (ret < 0) {
        LOG_ERR("pwm_set_pulse_dt(): %d", ret);
    }

    switch (led->internal_state) {
    case INTERNAL_FADE_UP: {
        fade_up(led);
        break;
    }
    case INTERNAL_FADE_DOWN: {
        fade_down(led);
        break;
    }
    default: {
        __ASSERT(false, "Invalid internal state: %d", led->internal_state);
        break;
    }
    }

    k_mutex_unlock(&led->lock);
    k_work_schedule(dwork, K_MSEC(PWM_SLEEP_MS));
}

static void blink_work(struct k_work *work) {
    struct k_work_delayable *dwork = k_work_delayable_from_work(work);
    struct pwm_led *led = pwm_led_from_blink_work(dwork);
    enum led_state_internal new_state;
    uint32_t period;

    int ret = k_mutex_lock(&led->lock, K_NO_WAIT);
    if (ret < 0) {
        k_work_schedule(dwork, K_MSEC(TRY_AGAIN_MS));
        return;
    }

    if (led->state != LED_STATE_BLINK) {
        k_mutex_unlock(&led->lock);
        return;
    }

    switch (led->internal_state) {
    case INTERNAL_BLINK_ON: {
        period = 0u;
        new_state = INTERNAL_BLINK_OFF;
        break;
    }
    case INTERNAL_BLINK_OFF: {
        period = led->led.period;
        new_state = INTERNAL_BLINK_ON;
        break;
    }
    default: {
        __ASSERT(false, "Invalid internal state: %d", led->internal_state);
        k_mutex_unlock(&led->lock);
        return;
    }
    }

    ret = pwm_set_pulse_dt(&led->led, period);
    if (ret < 0) {
        LOG_ERR("pwm_set_pulse_dt(): %d", ret);
    } else {
        led->internal_state = new_state;
    }

    k_mutex_unlock(&led->lock);
    k_work_schedule(dwork, K_MSEC(SLEEP_TIME_MS));
}

static void init_leds(void) {
    for (size_t i = 0u; i < ARRAY_SIZE(pwm_leds); i++) {
        pwm_leds[i].next_width = 0;
        pwm_leds[i].step = pwm_leds[i].led.period / PWM_STEPS;
        k_mutex_init(&pwm_leds[i].lock);
        k_work_init_delayable(&pwm_leds[i].blink_work, blink_work);
        k_work_init_delayable(&pwm_leds[i].fade_work, fade_work);
        if (!pwm_is_ready_dt(&pwm_leds[i].led)) {
            LOG_ERR("PWM device not ready: %s", pwm_leds[i].led.dev->name);
            return;
        }
    }
}

static int update_led_blink_locked(struct pwm_led *led) {
    int ret = 0;

    switch (led->internal_state) {
    case INTERNAL_OFF:
    case INTERNAL_FADE_UP: {
        led->internal_state = INTERNAL_BLINK_ON;
        ret = pwm_set_pulse_dt(&led->led, led->led.period);
        break;
    }
    case INTERNAL_ON:
    case INTERNAL_FADE_DOWN: {
        led->internal_state = INTERNAL_BLINK_OFF;
        ret = pwm_set_pulse_dt(&led->led, 0u);
        break;
    }
    default: {
        ret = -EALREADY;
        break;
    }
    }

    if (ret < 0 && k_work_delayable_busy_get(&led->blink_work) != 0) {
        return ret;
    }

    return k_work_schedule(&led->blink_work, K_NO_WAIT);
}

static int update_led_fade_locked(struct pwm_led *led) {
    int ret = 0;

    switch (led->internal_state) {
    case INTERNAL_OFF:
    case INTERNAL_BLINK_OFF: {
        led->internal_state = INTERNAL_FADE_UP;
        ret = pwm_set_pulse_dt(&led->led, 0u);
        break;
    }
    case INTERNAL_ON:
    case INTERNAL_BLINK_ON: {
        led->internal_state = INTERNAL_FADE_DOWN;
        ret = pwm_set_pulse_dt(&led->led, led->led.period);
        break;
    }
    default: {
        ret = -EALREADY;
        break;
    }
    }

    if (ret < 0 && k_work_delayable_busy_get(&led->fade_work) != 0) {
        return ret;
    }

    return k_work_schedule(&led->fade_work, K_NO_WAIT);
}

static int update_led_state_locked(struct pwm_led *led,
                                   enum led_state new_state) {
    int ret;

    switch (new_state) {
    case LED_STATE_ON: {
        ret = pwm_set_pulse_dt(&led->led, led->led.period);
        break;
    }
    case LED_STATE_OFF: {
        ret = pwm_set_pulse_dt(&led->led, 0u);
        break;
    }
    case LED_STATE_BLINK: {
        ret = update_led_blink_locked(led);
        break;
    }
    case LED_STATE_FADE: {
        ret = update_led_fade_locked(led);
        break;
    }
    default: {
        ret = -EINVAL;
        break;
    }
    }

    if (ret > 0) {
        return 0;
    }

    return ret;
}

static void start_leds(void) {
    init_leds();

    for (size_t i = 0u; i < ARRAY_SIZE(pwm_leds); i++) {
        k_mutex_lock(&pwm_leds[i].lock, K_FOREVER);
        (void)update_led_state_locked(&pwm_leds[i], pwm_leds[i].state);
        k_mutex_unlock(&pwm_leds[i].lock);
    }
}

static int update_led_state_(enum led led_, uint8_t new_state) {
    int ret;
    struct pwm_led *led = &pwm_leds[led_];

    k_mutex_lock(&led->lock, K_FOREVER);
    if (new_state == led->state) {
        k_mutex_unlock(&led->lock);
        return -EALREADY;
    }

    led->state = new_state;
    ret = update_led_state_locked(led, new_state);
    k_mutex_unlock(&led->lock);

    return ret;
}

int update_led_state(enum led led, uint8_t new_state) {
    if (led >= LED_INVALID) {
        return -EINVAL;
    }

    if (new_state >= LED_STATE_INVALID) {
        return pwm_leds[led].state;
    }

    return update_led_state_(led, new_state);
}

int main(void) {
    start_leds();

    return 0;
}
```

## include/led.h
```c
/**
 * @file led.h
 *
 * @brief LED API.
 *
 * @date 4/6/26
 *
 * @author Tom Schmitz \<tschmitz@andrew.cmu.edu\>
 */

#ifndef ARES_LED_H
#define ARES_LED_H

#include <stdint.h>

/**
 * @enum led_state
 * Different states the LED can be in.
 */
enum led_state {
    LED_STATE_OFF,     ///< LED off.
    LED_STATE_ON,      ///< LED on.
    LED_STATE_BLINK,   ///< LED blinking.
    LED_STATE_FADE,    ///< LED Fading on and off.
    LED_STATE_INVALID, ///< Invalid/end of enumeration.
};

/**
 * @enum led
 * LEDs that can be controlled.
 */
enum led {
    LED_0,       ///< LED 0
    LED_1,       ///< LED 1
    LED_INVALID, ///< Last LED enumerator
};

/**
 * Update or retrieve the LED state.
 *
 * @param[in] led The LED to update the state for.
 * @param[in] new_state The new state of the LED. If invalid, retrieves the
 * current state.
 *
 * @return The current state of the LED if `new_state` is invalid.
 * @return 0 if new state was set successfully.
 * @return -EAGAIN if state is unchanged from previous setting.
 * @return negative error code otherwise.
 */
int update_led_state(enum led led, uint8_t new_state);

#endif // ARES_LED_H
```

## include/lora.h
```c
/**
 * @file lora.h
 *
 * @brief
 *
 * @date 3/19/26
 *
 * @author Tom Schmitz \<tschmitz@andrew.cmu.edu\>
 */

#ifndef ARES_LORA_H
#define ARES_LORA_H

#include <zephyr/kernel.h>

enum lora_payload_type {
    START_TIME,
};

struct lora_payload {
    enum lora_payload_type type;
    union {
        struct {
            int64_t second;
            uint64_t nanosecond;
        };
    };
};

int ares_lora_send(const struct lora_payload *data, uint8_t repeat_count,
                   k_timeout_t interval);

extern struct k_msgq lora_rx_q;

#endif // ARES_LORA_H
```

## include/lora_frame.h
```c
/**
 * @file lora_frame.h
 *
 * @brief
 *
 * @date 3/19/26
 *
 * @author Tom Schmitz \<tschmitz@andrew.cmu.edu\>
 */

#ifndef ARES_LORA_FRAME_H
#define ARES_LORA_FRAME_H

#include <zephyr/kernel.h>

struct lora_frame {
    uint8_t seq_cnt;
    uint64_t id;
    int64_t second;
    uint64_t nanosecond;
};

enum lora_frame_check_result {
    LORA_FRAME_CHECK_OK,
    LORA_FRAME_INVALID,
    LORA_FRAME_BAD_CRC,
};

int serialize_lora_frame(uint8_t *buf, size_t len,
                         const struct lora_frame *frame);
enum lora_frame_check_result check_lora_frame(const uint8_t *buf, size_t len);
int deserialize_lora_frame(const uint8_t *buf, size_t len,
                           struct lora_frame *frame);

extern const size_t lora_frame_size;

#endif // ARES_LORA_FRAME_H
```

## include/lora_handlers.h
```c
/**
 * @file lora_handlers.h
 *
 * @brief LoRa packet handler APIs.
 *
 * @date 3/30/26
 *
 * @author Tom Schmitz \<tschmitz@andrew.cmu.edu\>
 */

#ifndef ARES_LORA_HANDLERS_H
#define ARES_LORA_HANDLERS_H

/**
 * Tell the LoRa module that the node ID and/or PAN ID were updated and to sync
 * to the new settings.
 */
void refresh_modem_id(void);

#endif // ARES_LORA_HANDLERS_H
```

## include/settings.h
```c
/**
 * @file settings.h
 *
 * @brief Ares-LoRa settings manager.
 *
 * @date 3/27/26
 *
 * @author Tom Schmitz \<tschmitz@andrew.cmu.edu\>
 */

#ifndef ARES_SETTINGS_H
#define ARES_SETTINGS_H

#include <zephyr/kernel.h>

/**
 * The settings for Ares-LoRa, their defaults, and bounds.
 *
 * - Node ID
 * - Wait for USB
 * - Personal Area Network ID
 * - Repetition count
 * .
 *
 * Format: setting name, default value, minimum value, maximum value.
 *
 * @param FUNC The generator macro function.
 */
#define FOREACH_ARES_SETTING(FUNC)                                             \
    FUNC(ID, 0, 1, 0xFFFF)                                                     \
    FUNC(WAIT_USB_HOST, 0, 0, 1)                                               \
    FUNC(PANID, 0, 0, 0xFFFF)                                                  \
    FUNC(REPCNT, 10, 1, 0xFFFFFFFF)

/**
 * Helper for generating the enumerations for Ares-LoRa settings.
 * @param setting_ The setting name.
 */
#define GENERATE_ENUM(setting_, ...) UTIL_CAT(ARES_SETTING_, setting_),

/**
 * @enum ares_setting
 *
 * Represents various settings for Ares-LoRa.
 *
 * @note This enumeration is automatically with @ref FOREACH_ARES_SETTING
 * "FOREACH_ARES_SETTING" and
 * @ref GENERATE_ENUM "GENERATE_ENUM". Please refer to @ref FOREACH_ARES_SETTING
 * "FOREACH_ARES_SETTING" to get a complete list of settings generated.
 */
enum ares_setting {
    FOREACH_ARES_SETTING(GENERATE_ENUM)
        ARES_SETTING_RESERVED ///< Reserved settings enumerator indicating the
                              ///< last setting.
};

#undef GENERATE_ENUM

/**
 * Write a new value for a setting.
 *
 * @param[in] setting The setting to update.
 * @param[in] value The new value of the setting.
 *
 * @return 0 on success.
 * @return -EINVAL if setting is invalid.
 * @return -ERANGE if the setting is out of range.
 * @return negative error code otherwise.
 */
int update_setting(enum ares_setting setting, uint32_t value);

/**
 * Read the given setting value.
 *
 * @param[in] setting The setting to read.
 * @param[out] value A pointer to the container for the setting.
 *
 * @return 0 on success.
 * @return -EINVAL if setting is invalid or `value` is NULL.
 */
int retrieve_setting(enum ares_setting setting, uint32_t *value);

/**
 * Resets all the settings to their default values.
 */
void reset_settings(void);

#endif // ARES_SETTINGS_H
```

## src/lora.c
```c
/**
 * @file lora.c
 *
 * @brief
 *
 * @date 3/19/26
 *
 * @author Tom Schmitz \<tschmitz@andrew.cmu.edu\>
 */

#include <lora.h>
#include <lora_frame.h>
#include <zephyr/device.h>
#include <zephyr/drivers/lora.h>
#include <zephyr/kernel.h>
#include <zephyr/logging/log.h>

LOG_MODULE_REGISTER(lora, CONFIG_LORA_LOG_LEVEL);

const struct device *const lora_dev = DEVICE_DT_GET_OR_NULL(DT_ALIAS(lora0));

K_MSGQ_DEFINE(lora_rx_q, sizeof(struct lora_payload), 10, 1);

void lora_receive_cb(const struct device *dev, uint8_t *data, uint16_t size,
                     int16_t rssi, int8_t snr, void *user_data) {
    ARG_UNUSED(dev);

    LOG_HEXDUMP_DBG(data, size, "LoRa RX payload");
}

int ares_lora_config(void) {
    struct lora_modem_config config = {};
    int ret;

    if (!device_is_ready(lora_dev)) {
        LOG_ERR("%s: device is not ready", lora_dev->name);
        return -ENODEV;
    }

    config.frequency = 915000000;
    config.bandwidth = BW_125_KHZ;
    config.datarate = SF_12;
    config.preamble_len = 8;
    config.coding_rate = CR_4_5;
    config.iq_inverted = false;
    config.public_network = false;
    config.tx_power = 4;
    config.tx = !IS_ENABLED(CONFIG_ARES_LORA_RX);

    ret = lora_config(lora_dev, &config);
    if (ret < 0) {
        LOG_ERR("LoRa config failed: %d", ret);
        return ret;
    }

    LOG_INF("LoRa configured");

#if IS_ENABLED(ARES_LORA_RX)
    ret = lora_recv_async(lora_dev, lora_receive_cb, NULL);
    if (ret < 0) {
        LOG_ERR("Failed to set LoRa async rx callback: %d", ret);
        return ret;
    }
#endif // IS_ENABLED(ARES_LORA_RX)

    return 0;
}

int ares_lora_send(const struct lora_payload *data, uint8_t repeat_count,
                   k_timeout_t interval) {
    static uint64_t send_id = UINT64_C(0);
    uint8_t serial_frame[lora_frame_size];
    int ret;

    if (data == NULL || repeat_count == UINT8_C(0)) {
        return -EINVAL;
    }

    for (uint8_t i = 0; i < repeat_count; i++) {
        struct lora_frame frame = {
            .id = send_id,
            .seq_cnt = i,
            .second = data->second,
            .nanosecond = data->nanosecond,
        };

        ret = serialize_lora_frame(serial_frame, sizeof(serial_frame), &frame);
        if (ret < 0) {
            LOG_ERR("Failed to create LoRa frame: %d", ret);
            return ret;
        }

        ret = lora_send(lora_dev, serial_frame, sizeof(serial_frame));
        if (ret < 0) {
            LOG_ERR("LoRa send failed");
            return ret;
        }

        if (i < (repeat_count - 1)) {
            (void)k_sleep(interval);
        }
    }

    LOG_INF("Message sent over LoRa %d times", repeat_count);

    return 0;
}
```

## src/lora_frame.c
```c
/**
 * @file lora_frame.c
 *
 * @brief
 *
 * @date 3/19/26
 *
 * @author Tom Schmitz \<tschmitz@andrew.cmu.edu\>
 */

#include <lora_frame.h>
#include <zephyr/kernel.h>
#include <zephyr/sys/crc.h>

#define LORA_FRAME_SEND_ID_OVERHEAD 8
#define LORA_FRAME_SEQ_CNT_OVERHEAD 1
#define LORA_FRAME_SECONDS_OVERHEAD 8
#define LORA_FRAME_NS_OVERHEAD      8
#define LORA_FRAME_CRC_OVERHEAD     2

#define LORA_FRAME_MSG_OVERHEAD                                                \
    (LORA_FRAME_SEND_ID_OVERHEAD + LORA_FRAME_SEQ_CNT_OVERHEAD +               \
     LORA_FRAME_SECONDS_OVERHEAD + LORA_FRAME_NS_OVERHEAD)
#define LORA_FRAME_OVERHEAD       (LORA_FRAME_MSG_OVERHEAD + LORA_FRAME_CRC_OVERHEAD)

#define LORA_FRAME_SEND_ID_OFFSET 0
#define LORA_FRAME_SEQ_CNT_OFFSET                                              \
    (LORA_FRAME_SEND_ID_OFFSET + LORA_FRAME_SEND_ID_OVERHEAD)
#define LORA_FRAME_SECONDS_OFFSET                                              \
    (LORA_FRAME_SEQ_CNT_OFFSET + LORA_FRAME_SEQ_CNT_OVERHEAD)
#define LORA_FRAME_NS_OFFSET                                                   \
    (LORA_FRAME_SECONDS_OFFSET + LORA_FRAME_SECONDS_OVERHEAD)
#define LORA_FRAME_CRC_OFFSET (LORA_FRAME_NS_OFFSET + LORA_FRAME_NS_OVERHEAD)

const size_t lora_frame_size = LORA_FRAME_OVERHEAD;

static void serialize_field(uint8_t *buf, const uint64_t field,
                            size_t field_size) {
    size_t i = 0;
    for (; i < field_size; i++) {
        buf[i] = (field >> (i * CHAR_BIT)) & UINT8_MAX;
    }
}

#define SERIALIZE(buf_, field_) serialize_field(buf_, field_, sizeof(field_))

static void deserialize_field(const uint8_t *buf, void *field,
                              size_t field_size) {
    uint8_t *field_ = field;
    for (size_t i = 0; i < field_size; i++) {
        field_[i] = buf[i];
    }
}

#define DESERIALIZE(buf_, field_)                                              \
    deserialize_field(buf_, &field_, sizeof(field_))

#define REVERSE_2(x)  ((((x)&1) << 1) | (((x) >> 1) & 1))
#define REVERSE_4(x)  ((REVERSE_2(x) << 2) | (REVERSE_2(x) >> 2))
#define REVERSE_8(x)  ((REVERSE_4(x) << 4) | (REVERSE_4(x) >> 4))
#define REVERSE_16(x) ((REVERSE_8(x) << 8) | (REVERSE_8(x) >> 8))

static void reflect(uint8_t *buf, size_t len) {
    for (size_t i = 0; i < len; i++) {
        buf[i] = REVERSE_8(buf[i]);
    }
}

static uint16_t compute_crc(const uint8_t *buf, size_t len) {
    uint16_t ret;

#if !IS_ENABLED(CONFIG_LORA_REFLECT_INPUT)
    uint8_t reflected_data[LORA_FRAME_MSG_OVERHEAD];
    (void)memcpy(reflected_data, buf, len);
    reflect(reflected_data, len);
    ret = crc16(CONFIG_LORA_CRC_POLYNOMIAL, CONFIG_LORA_CRC_SEED,
                reflected_data, len);
#else
    ret = crc16(CONFIG_LORA_CRC_POLYNOMIAL, CONFIG_LORA_CRC_SEED, buf, len);
#endif // !IS_ENABLED(CONFIG_LORA_REFLECT_INPUT)

#if !IS_ENABLED(CONFIG_LORA_REFLECT_CRC_OUTPUT)
    ret = REVERSE_16(ret);
#endif // !IS_ENABLED(CONFIG_LORA_REFLECT_CRC_OUTPUT)

    return ret ^ CONFIG_LORA_CRC_XOR_OUTPUT;
}

int serialize_lora_frame(uint8_t *buf, size_t len,
                         const struct lora_frame *frame) {
    uint16_t crc;

    if (len < lora_frame_size) {
        return -ENOBUFS;
    }

    if (buf == NULL || frame == NULL) {
        return -EINVAL;
    }

    SERIALIZE(buf + LORA_FRAME_SEND_ID_OFFSET, frame->id);
    SERIALIZE(buf + LORA_FRAME_SEQ_CNT_OFFSET, frame->seq_cnt);
    SERIALIZE(buf + LORA_FRAME_SECONDS_OFFSET, frame->second);
    SERIALIZE(buf + LORA_FRAME_NS_OFFSET, frame->nanosecond);

    crc = compute_crc(buf, LORA_FRAME_MSG_OVERHEAD);

    SERIALIZE(buf + LORA_FRAME_CRC_OFFSET, crc);

    return 0;
}

enum lora_frame_check_result check_lora_frame(const uint8_t *buf, size_t len) {
    uint16_t rx_crc, crc;

    if (len < lora_frame_size || buf == NULL) {
        return LORA_FRAME_INVALID;
    }

    DESERIALIZE(buf + LORA_FRAME_CRC_OFFSET, rx_crc);
    crc = compute_crc(buf, LORA_FRAME_MSG_OVERHEAD);

    return (rx_crc == crc) ? LORA_FRAME_CHECK_OK : LORA_FRAME_BAD_CRC;
}

int deserialize_lora_frame(const uint8_t *buf, size_t len,
                           struct lora_frame *frame) {
    enum lora_frame_check_result check;
    if (len < lora_frame_size || buf == NULL || frame == NULL) {
        return -EINVAL;
    }

    check = check_lora_frame(buf, len);
    if (check != LORA_FRAME_CHECK_OK) {
        return -EBADMSG;
    }

    DESERIALIZE(buf + LORA_FRAME_SEND_ID_OFFSET, frame->id);
    DESERIALIZE(buf + LORA_FRAME_SEQ_CNT_OFFSET, frame->seq_cnt);
    DESERIALIZE(buf + LORA_FRAME_SECONDS_OFFSET, frame->second);
    DESERIALIZE(buf + LORA_FRAME_NS_OFFSET, frame->nanosecond);

    return 0;
}
```

## src/lora_handlers.c
```c
/**
 * @file lora_handlers.c
 *
 * @brief
 *
 * @date 3/30/26
 *
 * @author Tom Schmitz \<tschmitz@andrew.cmu.edu\>
 */

#include <lora/lora.h>
#include <lora/lora_backend.h>
#include <lora/packet.h>
#include <lora_handlers.h>
#include <serial/frame.h>
#include <serial/serial.h>
#include <serial/serial_backend.h>
#include <settings.h>
#include <zephyr/init.h>
#include <zephyr/kernel.h>

struct modem_id {
    uint16_t pan_id;
    uint16_t id;
};

static struct modem_id modem_id;

#define CHECK_DIRECTED_PACKET(packet)                                          \
    do {                                                                       \
        if ((packet)->type == ARES_PKT_TYPE_DIRECT &&                          \
            ((packet)->destination_id != modem_id.id ||                        \
             (packet)->pan_id != modem_id.pan_id)) {                           \
            return;                                                            \
        }                                                                      \
    } while (0)

#define DIRECTED_PACKET_REQUIRED(packet)                                       \
    do {                                                                       \
        if ((packet)->type != ARES_PKT_TYPE_DIRECT ||                          \
            ((packet)->destination_id != modem_id.id ||                        \
             (packet)->pan_id != modem_id.pan_id)) {                           \
            return;                                                            \
        }                                                                      \
    } while (0)

static void handle_start(const struct ares_lora *lora,
                         const struct ares_packet *packet) {
    ARG_UNUSED(lora);

    const struct ares_serial *serial = ares_serial_backend_uart_get_ptr();
    struct ares_frame frame = {
        .type = ARES_FRAME_START,
    };

    CHECK_DIRECTED_PACKET(packet);

    frame.payload.START.id = packet->source_id;
    frame.payload.START.broadcast = packet->type == ARES_PKT_TYPE_BROADCAST;
    frame.payload.START.sec = packet->payload.payload.START.sec;
    frame.payload.START.usec = packet->payload.payload.START.usec;
    frame.payload.START.seq_cnt = packet->sequence_cnt;
    frame.payload.START.packet_id = packet->packet_id;

    ares_serial_write_frame(serial, &frame);
}

static void handle_poll(const struct ares_lora *lora,
                        const struct ares_packet *packet) {
    ARG_UNUSED(lora);

    const struct ares_serial *serial = ares_serial_backend_uart_get_ptr();
    struct ares_frame frame = {
        .type = ARES_FRAME_POLL,
        .payload.POLL = packet->source_id,
    };

    DIRECTED_PACKET_REQUIRED(packet);

    ares_serial_write_frame(serial, &frame);
}

static void handle_heartbeat(const struct ares_lora *lora,
                             const struct ares_packet *packet) {
    ARG_UNUSED(lora);

    const struct ares_serial *serial = ares_serial_backend_uart_get_ptr();
    struct ares_frame frame = {
        .type = ARES_FRAME_HEARTBEAT,
    };

    DIRECTED_PACKET_REQUIRED(packet);

    frame.payload.HEARTBEAT.flags.ready =
        packet->payload.payload.HEARTBEAT.ready;
    frame.payload.HEARTBEAT.id = packet->source_id;

    ares_serial_write_frame(serial, &frame);
}

static void handle_log(const struct ares_lora *lora,
                       const struct ares_packet *packet) {
    const struct ares_serial *serial = ares_serial_backend_uart_get_ptr();
    struct ares_frame frame = {
        .type = ARES_FRAME_LOG,
        .payload.LOG =
            {
                .broadcast = packet->type == ARES_PKT_TYPE_BROADCAST,
                .id = packet->source_id,
                .part = packet->payload.payload.LOG.part,
                .num_parts = packet->payload.payload.LOG.num_parts,
                .log_id = packet->payload.payload.LOG.log_id,
                .msg = packet->payload.payload.LOG.msg,
                .msg_len = packet->payload.payload.LOG.msg_len,
            },
    };

    CHECK_DIRECTED_PACKET(packet);

    int ret = ares_serial_write_frame(serial, &frame);
    if (ret < 0) {
        frame.type = ARES_FRAME_DBG;
        frame.payload.DBG = ret;
        ares_serial_write_frame(serial, &frame);
    }
}

static void handle_log_ack(const struct ares_lora *lora,
                           const struct ares_packet *packet) {
    ARG_UNUSED(lora);
    const struct ares_serial *serial = ares_serial_backend_uart_get_ptr();
    struct ares_frame frame = {
        .type = ARES_FRAME_LOG_ACK,
        .payload.LOG_ACK =
            {
                .part = packet->payload.payload.LOG_ACK.part,
                .num_parts = packet->payload.payload.LOG_ACK.num_parts,
                .id = packet->source_id,
                .log_id = packet->payload.payload.LOG_ACK.log_id,
            },
    };

    DIRECTED_PACKET_REQUIRED(packet);

    ares_serial_write_frame(serial, &frame);
}

static void handle_ack(const struct ares_lora *lora,
                       const struct ares_packet *packet) {
    ARG_UNUSED(lora);
    const struct ares_serial *serial = ares_serial_backend_uart_get_ptr();
    struct ares_frame frame = {
        .type = ARES_FRAME_LORA_ACK,
        .payload.LORA_ACK =
            {
                .id = packet->source_id,
                .payload_type = packet->payload.payload.ACK,
            },
    };

    DIRECTED_PACKET_REQUIRED(packet);

    ares_serial_write_frame(serial, &frame);
}

static void handle_abort(const struct ares_lora *lora,
                         const struct ares_packet *packet) {
    ARG_UNUSED(lora);
    const struct ares_serial *serial = ares_serial_backend_uart_get_ptr();
    struct ares_frame frame = {
        .type = ARES_FRAME_ABORT,
        .payload.ABORT =
            {
                .id = packet->source_id,
                .flags.broadcast = packet->type == ARES_PKT_TYPE_BROADCAST,
            },
    };

    CHECK_DIRECTED_PACKET(packet);

    ares_serial_write_frame(serial, &frame);
}

static void handle_config(const struct ares_lora *lora,
                          const struct ares_packet *packet) {
    ARG_UNUSED(lora);
    const struct ares_serial *serial = ares_serial_backend_uart_get_ptr();
    struct ares_frame frame = {
        .type = ARES_FRAME_NODE_CONFIG,
        .payload.NODE_CONFIG =
            {
                .type = packet->payload.payload.CONFIG_.type,
                .id = packet->source_id,
                .config = packet->payload.payload.CONFIG_.config,
            },
    };

    DIRECTED_PACKET_REQUIRED(packet);

    ares_serial_write_frame(serial, &frame);
}

static void handle_config_poll(const struct ares_lora *lora,
                               const struct ares_packet *packet) {
    ARG_UNUSED(lora);
    const struct ares_serial *serial = ares_serial_backend_uart_get_ptr();
    struct ares_frame frame = {
        .type = ARES_FRAME_NODE_CONFIG_POLL,
        .payload.NODE_CONFIG_POLL =
            {
                .type = packet->payload.payload.CONFIG_POLL_,
                .id = packet->source_id,
            },
    };

    DIRECTED_PACKET_REQUIRED(packet);

    ares_serial_write_frame(serial, &frame);
}

static void handle_config_poll_response(const struct ares_lora *lora,
                                        const struct ares_packet *packet) {
    ARG_UNUSED(lora);
    const struct ares_serial *serial = ares_serial_backend_uart_get_ptr();
    struct ares_frame frame = {
        .type = ARES_FRAME_NODE_CONFIG_RESP,
        .payload.NODE_CONFIG_RESP =
            {
                .id = packet->source_id,
                .config = packet->payload.payload.CONFIG_RESP_.config,
                .type = packet->payload.payload.CONFIG_RESP_.type,
            },
    };

    DIRECTED_PACKET_REQUIRED(packet);

    ares_serial_write_frame(serial, &frame);
}

static void handle_ready(const struct ares_lora *lora,
                         const struct ares_packet *packet) {
    ARG_UNUSED(lora);
    const struct ares_serial *serial = ares_serial_backend_uart_get_ptr();
    struct ares_frame frame = {
        .type = ARES_FRAME_NODE_READY,
        .payload.NODE_READY =
            {
                .id = packet->source_id,
                .flags.broadcast = packet->type == ARES_PKT_TYPE_BROADCAST,
            },
    };

    CHECK_DIRECTED_PACKET(packet);

    ares_serial_write_frame(serial, &frame);
}

static struct ares_lora_command commands[] = {
    {ARES_PKT_PAYLOAD_START, handle_start},
    {ARES_PKT_PAYLOAD_POLL, handle_poll},
    {ARES_PKT_PAYLOAD_HEARTBEAT, handle_heartbeat},
    {ARES_PKT_PAYLOAD_LOG, handle_log},
    {ARES_PKT_PAYLOAD_LOG_ACK, handle_log_ack},
    {ARES_PKT_PAYLOAD_ACK, handle_ack},
    {ARES_PKT_PAYLOAD_ABORT, handle_abort},
    {ARES_PKT_PAYLOAD_CONFIG, handle_config},
    {ARES_PKT_PAYLOAD_CONFIG_POLL, handle_config_poll},
    {ARES_PKT_PAYLOAD_CONFIG_RESP, handle_config_poll_response},
    {ARES_PKT_PAYLOAD_READY, handle_ready},
};

static int init_lora_handlers(void) {
    const struct ares_lora *lora = ares_lora_backend_lora_get_ptr();
    refresh_modem_id();
    return ares_lora_register_command_callbacks(lora, commands,
                                                ARRAY_SIZE(commands));
}
SYS_INIT(init_lora_handlers, APPLICATION, 91);

void refresh_modem_id(void) {
    uint32_t pan, id;

    retrieve_setting(ARES_SETTING_PANID, &pan);
    retrieve_setting(ARES_SETTING_ID, &id);

    modem_id.id = (uint16_t)id;
    modem_id.pan_id = (uint16_t)pan;
}
```

## src/settings.c
```c
/**
 * @file settings.c
 *
 * @brief
 *
 * @date 3/27/26
 *
 * @author Tom Schmitz \<tschmitz@andrew.cmu.edu\>
 */

#include <settings.h>
#include <stdio.h>
#include <zephyr/init.h>
#include <zephyr/kernel.h>
#include <zephyr/settings/settings.h>

#if defined(CONFIG_SETTINGS_FILE)
#include <zephyr/fs/fs.h>
#include <zephyr/fs/littlefs.h>
#endif

#define STORAGE_PARTITION_ID FIXED_PARTITION_ID(storage_partition)

struct ares_settings_dict {
    const char *key;
    uint32_t value;
};

struct ares_settings_meta {
    uint32_t default_val;
    uint32_t min_val;
    uint32_t max_val;
};

#define GENERATE_ARES_DEFAULTS(name_, value_, min_, max_) {value_, min_, max_},

static const struct ares_settings_meta meta[] = {
    FOREACH_ARES_SETTING(GENERATE_ARES_DEFAULTS)};

#undef GENERATE_ARES_DEFAULTS

#define GENERATE_ARES_SETTINGS(name_, value_, ...) {#name_, value_},

static struct ares_settings_dict settings[] = {
    FOREACH_ARES_SETTING(GENERATE_ARES_SETTINGS)};

#undef GENERATE_ARES_SETTINGS

#define MAX_NAME_LENGTH SETTINGS_MAX_NAME_LEN

static int handle_get(const char *name, char *val, int val_len_max) {
    ARG_UNUSED(val_len_max);
    const char *next;

    for (size_t i = 0; i < ARRAY_SIZE(settings); i++) {
        if (settings_name_steq(name, settings[i].key, &next) && !next) {
            memcpy(val, &settings[i].value, sizeof(settings[0].value));
            return sizeof(settings[0].value);
        }
    }

    return -ENOENT;
}

static int handle_set(const char *name, size_t len, settings_read_cb read_cb,
                      void *cb_arg) {
    ARG_UNUSED(len);
    const char *next;
    size_t name_len;
    int rc = -ENOENT;

    name_len = settings_name_next(name, &next);

    for (size_t i = 0; (i < ARRAY_SIZE(settings)) && !next; i++) {
        if (strncmp(name, settings[i].key, name_len) == 0) {
            rc = read_cb(cb_arg, &settings[i].value, sizeof(settings[0].value));
            break;
        }
    }

    return rc;
}

static int handle_commit(void) { return 0; }

static int handle_export(int (*cb)(const char *name, const void *value,
                                   size_t val_len)) {
    char name[MAX_NAME_LENGTH + 1];

    for (size_t i = 0; i < ARRAY_SIZE(settings); i++) {
        snprintf(name, MAX_NAME_LENGTH, "ares/'%s", settings[i].key);
        (void)cb(name, &settings[i].value, sizeof(settings[0].value));
    }

    return 0;
}

SETTINGS_STATIC_HANDLER_DEFINE(ares_settings, "ares", handle_get, handle_set,
                               handle_commit, handle_export);

int update_setting(enum ares_setting setting, uint32_t value) {
    char name[MAX_NAME_LENGTH + 1];
    int rc;

    if (setting >= ARES_SETTING_RESERVED) {
        return -EINVAL;
    }

    if (value < meta[setting].min_val || value > meta[setting].max_val) {
        return -ERANGE;
    }

    snprintf(name, MAX_NAME_LENGTH, "ares/%s", settings[setting].key);

    rc = settings_save_one(name, &value, sizeof(value));

    if (rc == 0) {
        settings[setting].value = value;
    }

    return 0;
}

int retrieve_setting(enum ares_setting setting, uint32_t *value) {
    if (setting >= ARES_SETTING_RESERVED || value == NULL) {
        return -EINVAL;
    }

    *value = settings[setting].value;
    return 0;
}

void reset_settings(void) {
    for (size_t i = 0; i < ARRAY_SIZE(settings); i++) {
        settings[i].value = meta[i].default_val;
    }

    settings_save();
}

static int init_settings(void) {
    int rc;

    __ASSERT_NO_MSG(ARRAY_SIZE(defaults) == ARRAY_SIZE(settings));

#if defined(CONFIG_SETTINGS_FILE)
    FS_LITTLEFS_DECLARE_DEFAULT_CONFIG(cstorage);

    static struct fs_mount littlefs_mnt = {.type = FS_LITTLEFS,
                                           .fs_data = &cstorage,
                                           .storage_dev =
                                               (void *)STORAGE_PARTITION_ID,
                                           .mnt_point = "/ff"};

    rc = fs_mount(&littlefs_mnt);
    if (rc != 0) {
        return rc;
    }

    rc = fs_unlink(CONFIG_SETTINGS_FILE_PATH);
    if ((rc != 0) && (rc != -ENOENT)) {
        return rc;
    }
#endif

    rc = settings_subsys_init();

    if (rc != 0) {
        return rc;
    }

    return settings_load();
}
SYS_INIT(init_settings, APPLICATION, 10);
```
