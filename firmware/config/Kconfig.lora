## firmware/config/Kconfig.lora
```kconfig
menu "LoRa Configurations"

config ARES_LORA_STACK_SIZE
    int "LoRa task stack size"
    default 4096

config ARES_LORA_PRIO
    int "LoRa task priority"
    default 1

config ARES_LORA_TX_RINGBUF_SIZE
    int "LoRa TX ring buffer size"
    default 512

config ARES_LORA_RX_RINGBUF_SIZE
    int "LoRa RX ring buffer size"
    default 512

config ARES_LORA_TRX_BUF_SIZE
    int "LoRa TRX buffer size"
    default 512

menu "CRC Configurations"

config LORA_CRC_SEED
    hex "CRC16 Seed"
    default 0xFFFF

config LORA_CRC_XOR_OUTPUT
    hex "XOR CRC16 output value"
    default 0xFFFF

config LORA_REFLECT_CRC_OUTPUT
    bool "Reflect the CRC16 output"
    default n

config LORA_CRC_POLYNOMIAL
    hex "CRC16 polynomial"
    default 0x9eb2

endmenu # CRC Configurations

endmenu  # LoRa Configurations
```
