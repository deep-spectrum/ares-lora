/ {
	aliases {
		// For nrf52840dk
		//mcuboot-led0 = &led2;

		// For the rak
		mcuboot-led0 = &green_led;
	};
};

&zephyr_udc0 {
	cdc_acm_uart0: cdc_acm_uart0 {
		compatible = "zephyr,cdc-acm-uart";
	};
};
